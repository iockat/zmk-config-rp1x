## config/boards/shields/rp1x/Kconfig.defconfig
```kconfig
if SHIELD_RP1X_LEFT

config ZMK_KEYBOARD_NAME
    default "RP1X"

config ZMK_SPLIT_ROLE_CENTRAL
    default y

endif

if SHIELD_RP1X_LEFT || SHIELD_RP1X_RIGHT

config ZMK_SPLIT
    default y

endif
```

## config/boards/shields/rp1x/Kconfig.shield
```kconfig
config SHIELD_RP1X_LEFT
    def_bool $(shields_list_contains,rp1x_left)

config SHIELD_RP1X_RIGHT
    def_bool $(shields_list_contains,rp1x_right)
```
